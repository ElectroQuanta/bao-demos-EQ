/dts-v1/;
// magic:		0xd00dfeed
// totalsize:		0x3dc (988)
// off_dt_struct:	0x38
// off_dt_strings:	0x344
// off_mem_rsvmap:	0x28
// version:		17
// last_comp_version:	16
// boot_cpuid_phys:	0x0
// size_dt_strings:	0x98
// size_dt_struct:	0x30c

/ {
    compatible = "brcm,bcm2835";
    fragment@0 {
        target = <0xffffffff>;
        __overlay__ {
            pinctrl-names = "default";
            pinctrl-0 = <0x00000001>;
            status = "okay";
        };
    };
    fragment@1 {
        target = <0xffffffff>;
        __overlay__ {
            uart1_ovl_pins {
                brcm,pins = <0x0000000e 0x0000000f>;
                brcm,function = <0x00000002>;
                brcm,pull = <0x00000000 0x00000002>;
                phandle = <0x00000001>;
            };
        };
    ;
    fragment@2 {
        target-path = "/chosen";
        __overlay__ {
            bootargs = "8250.nr_uarts=1";
        };
    };
    __overrides__ {
        txd1_pin = <0x00000001 0x6272636d 0x2c70696e 0x733a3000>;
        rxd1_pin = <0x00000001 0x6272636d 0x2c70696e 0x733a3400>;
    };
    __symbols__ {
        uart1_pins = "/fragment@1/__overlay__/uart1_ovl_pins";
    };
    __fixups__ {
        uart1 = "/fragment@0:target:0";
        gpio = "/fragment@1:target:0";
    };
    __local_fixups__ {
        fragment@0 {
            __overlay__ {
                pinctrl-0 = <0x00000000>;
            };
        };
        __overrides__ {
            txd1_pin = <0x00000000>;
            rxd1_pin = <0x00000000>;
        };
    };
};
