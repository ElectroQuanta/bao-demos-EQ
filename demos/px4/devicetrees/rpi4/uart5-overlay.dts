/dts-v1/;
// magic:		0xd00dfeed
// totalsize:		0x1ed (493)
// off_dt_struct:	0x38
// off_dt_strings:	0x1a8
// off_mem_rsvmap:	0x28
// version:		17
// last_comp_version:	16
// boot_cpuid_phys:	0x0
// size_dt_strings:	0x45
// size_dt_struct:	0x170

/ {
    compatible = "brcm,bcm2711";
    fragment@0 {
        target = <0xffffffff>;
        __overlay__ {
            status = "okay";
        };
    };
    fragment@1 {
        target = <0xffffffff>;
        __dormant__ {
            brcm,pins = <0x0000000c 0x0000000d 0x0000000e 0x0000000f>;
            brcm,pull = <0x00000000 0x00000002 0x00000002 0x00000000>;
        };
    };
    __overrides__ {
        ctsrts = [00 00 00 00 3d 31 00];
    };
    __fixups__ {
        uart5 = "/fragment@0:target:0";
        uart5_pins = "/fragment@1:target:0";
    };
};
